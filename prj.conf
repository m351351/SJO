## CMakeLists.txt
```
cmake_minimum_required(VERSION 3.20.0)
find_package(Zephyr REQUIRED HINTS $ENV{ZEPHYR_BASE})

project(SJO)

target_sources(app PRIVATE src/main.c src/button.c)
```

## prj.conf
```kconfig
CONFIG_GPIO=y
CONFIG_CONSOLE=y
CONFIG_UART_CONSOLE=y
CONFIG_USE_SEGGER_RTT=n
```

## src/main.c
```c
// Tavoite oli kolme pistettä, mutta en saanut 2 pisteen asiaa toimimaan
//Yritin tehdä koodista modulaarisemman ja helpostiluettavan laittamalla button.c ja button.h tiedostot
//Ohjelma meni ihan nätisti tuon liikennevaloasian osalta, mutta mitään muuta kontaktia
//en sitten laitteeseen enää saanutkaan. Luennossa jossa opettaja kävi läpi 
//miten harjoitus tulee tehdä ei ollut ääntä, enkä löytänyt ohjevideota jossa olisi ollut äänikin mukana.

//Teoriassa tiedän miten ohjelman pitäisi toimia, mutta en kertakaikkiaan saanut sitä toimimaan käytännössä. Käytin tähän kokonaisen työpäivän.

//Perehdyn aiheeseen lisää myöhemmin, josko luennoilla selviäisi asioita tai saisin opiskelutovereilta vertaistukea.

#include <zephyr/kernel.h>
#include <zephyr/sys/printk.h>
#include <zephyr/device.h>
#include <zephyr/drivers/gpio.h>
#include "button.h"

static const struct gpio_dt_spec red = GPIO_DT_SPEC_GET(DT_ALIAS(led0), gpios);
static const struct gpio_dt_spec green = GPIO_DT_SPEC_GET(DT_ALIAS(led1), gpios);
static const struct gpio_dt_spec blue = GPIO_DT_SPEC_GET(DT_ALIAS(led2), gpios);
static const struct gpio_dt_spec yellow = GPIO_DT_SPEC_GET(DT_ALIAS(led3), gpios);

#define STACKSIZE 500
#define PRIORITY 5
void red_led_task(void *, void *, void*);
void green_led_task(void *, void *, void*);
void blue_led_task(void *, void *, void*);
void yellow_led_task(void *, void *, void*);

K_THREAD_DEFINE(red_thread,STACKSIZE,red_led_task,NULL,NULL,NULL,PRIORITY,0,0);
K_THREAD_DEFINE(green_thread,STACKSIZE,green_led_task,NULL,NULL,NULL,PRIORITY,0,0);
K_THREAD_DEFINE(yellow_thread,STACKSIZE,yellow_led_task,NULL,NULL,NULL,PRIORITY,0,0);

int tilakone = 0; 
int led_state = 0;

int init_led() {
	int ret;

	ret = gpio_pin_configure_dt(&red, GPIO_OUTPUT_ACTIVE);
	if (ret < 0) return ret;
	gpio_pin_set_dt(&red, 0);

	ret = gpio_pin_configure_dt(&green, GPIO_OUTPUT_ACTIVE);
	if (ret < 0) return ret;
	gpio_pin_set_dt(&green, 0);

	ret = gpio_pin_configure_dt(&blue, GPIO_OUTPUT_ACTIVE);
	if (ret < 0) return ret;
	gpio_pin_set_dt(&blue, 0);

	ret = gpio_pin_configure_dt(&yellow, GPIO_OUTPUT_ACTIVE);
	if (ret < 0) return ret;
	gpio_pin_set_dt(&yellow, 0);

	printk("Led initialized ok\n");
	return 0;
}

int main(void)
{
	init_led(); 
	init_button();

	while (1) {
		k_msleep(100);
	}

	return 0;
}

void red_led_task(void *, void *, void*) {
	printk("Red led thread started\n");
	while (true) {
		if (tilakone == 0){
			gpio_pin_set_dt(&red, 1);
			printk("Red on\n");
			k_sleep(K_SECONDS(1));
			gpio_pin_set_dt(&red, 0);
			printk("Red off\n");
			k_sleep(K_SECONDS(1));
			tilakone = 1;
		}
		k_sleep(K_SECONDS(1));
	}
}

void yellow_led_task(void *, void *, void*) {
	printk("Yellow led thread started\n");
	while (true) {
		if (tilakone == 1){
			gpio_pin_set_dt(&red, 1);
			gpio_pin_set_dt(&green, 1);
			printk("Yellow on\n");
			k_sleep(K_SECONDS(1));
			gpio_pin_set_dt(&red, 0);
			gpio_pin_set_dt(&green, 0);
			printk("Yellow off\n");
			tilakone = 2;
		}
		k_sleep(K_SECONDS(1));
	}
}

void green_led_task(void *, void *, void*) {
	printk("Green led thread started\n");
	while (true) {
		if (tilakone == 2){
			gpio_pin_set_dt(&green, 1);
			printk("Green on\n");
			k_sleep(K_SECONDS(1));
			gpio_pin_set_dt(&green, 0);
			printk("Green off\n");
			k_sleep(K_SECONDS(1));
			tilakone = 0;
		}
		k_sleep(K_SECONDS(1));
	}
}
```

## src/button.c
```c
#include <zephyr/kernel.h>
#include <zephyr/device.h>
#include <zephyr/drivers/gpio.h>
#include <zephyr/sys/util.h>
#include <zephyr/sys/printk.h>
#include <inttypes.h>
#include "button.h"

#define BUTTON_0 DT_ALIAS(sw0)
#define BUTTON_1 DT_ALIAS(sw1)
#define BUTTON_2 DT_ALIAS(sw2)
#define BUTTON_3 DT_ALIAS(sw3)
#define BUTTON_4 DT_ALIAS(sw4)

static const struct gpio_dt_spec button_0 = GPIO_DT_SPEC_GET_OR(BUTTON_0, gpios, {0});
static struct gpio_callback button_0_data;
static struct gpio_callback button_1_data;
static struct gpio_callback button_2_data;
static struct gpio_callback button_3_data;
static struct gpio_callback button_4_data;

int saved_state = 0;

void button_0_handler(const struct device *dev, struct gpio_callback *cb, uint32_t pins)
{
	printk("Button 0 PAUSE pressed\n");
    if (tilakone != 4) {
        saved_state = tilakone; 
        tilakone = 4;           
    } else {
        tilakone = saved_state; 
    }
}

static int tsekkaa_nappi (const struct gpio_dt_spec *button, struct gpio_callback *callback, gpio_callback_handler_t handler)
{
	if (!device_is_ready(button->port)) {
		printk("Error: button device %s is not ready\n", button->port->name);
		return -ENODEV;
	}

	// LISÄTTY GPIO_PULL_UP, jotta pinni ei leiju!
	int ret = gpio_pin_configure_dt(button, GPIO_INPUT | GPIO_PULL_UP);
	if (ret != 0) {
		printk("Error %d: failed to configure %s pin %d\n",
		       ret, button->port->name, button->pin);
		return ret;
	}

	ret = gpio_pin_interrupt_configure_dt(button, GPIO_INT_EDGE_TO_ACTIVE);
	if (ret != 0) {
		printk("Error %d: failed to configure interrupt on %s pin %d\n",
		       ret, button->port->name, button->pin);
		return ret;
	}

	gpio_init_callback(callback, handler, BIT(button->pin));
	gpio_add_callback(button->port, callback);
	printk("Set up button at %s pin %d\n", button->port->name, button->pin);

	return 0;
}

int init_button() {
	
	tsekkaa_nappi(&button_0, &button_0_data, button_0_handler);
	
	return 0;
}
```

## src/button.h
```c
#ifndef BUTTON_H
#define BUTTON_H

int init_button();
extern int tilakone;
extern int led_state; 
extern int saved_state;

#endif
```
