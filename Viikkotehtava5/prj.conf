## prj.conf
```kconfig
CONFIG_GPIO=y
CONFIG_LOG=y
CONFIG_SERIAL=y
CONFIG_UART_CONSOLE=y
CONFIG_LOG=y
CONFIG_HEAP_MEM_POOL_SIZE=1024
CONFIG_TIMING_FUNCTIONS=y
CONFIG_ASSERT=y
```

## src/main.c
```c
// Meri-Tuulia Turtinen
// TVT24SPL
// Tavoitellaan kolmea pistettä
// Tehty ensimmäisen pisteen suoritus eli testit ajettu ja siirretty varsinaiseen ohjelmaan
// Tehty toisen pisteen suoritus eli tehty lisää testikeissejä
// Lisänä myös oma pääsiäismuna --> syötä ajaksi 174400
// aloitettu kolmannen pisteen suoritus eli lisätty testausta liikennevaloihin
// testeissä toistaiseksi toimii kirjainten tsekkaus ja saa olla pilkku sekä numeroita
// mutta vielä ei toimi testi jossa hylättäis jos käyttäjä antaa kirjaimia ja numeroita, mutta
// ei erota niitä pilkulla
// kirjainten testausta ei ole vielä lisätty RTOS -ohjelmaan

// lisätty kopiot myös TimeParser.cpp, TimeParser.h ja TimeParserTest.cpp
// mutta varsinaiset testaukset olen tehnyt erillisellä ohjelmalla


#include <zephyr/kernel.h>
#include <zephyr/sys/printk.h>
#include <zephyr/device.h>
#include <zephyr/drivers/gpio.h>
#include <zephyr/timing/timing.h>
#include "button.h"
#include "uart.h"
#include "dispatcher.h"
#include "debug.h"
#include "led_task.h"
#include <ctype.h>

// Thread initializations
#define STACKSIZE 500
#define PRIORITY 5


volatile int tilakone = 0; 
int led_state = 0;
struct k_timer timer;
struct k_timer timer2;

int main(void)
{
    init_button();

    printk("Dispatcher example started\n");
    int ret = init_uart();
    if (ret != 0) {
        printk("UART initialization failed!\n");
        return ret;
    }
    
    ret = init_led();
    if (ret != 0) {
        printk("Led initialization failed!\n");
        return ret;
    }

    k_mutex_init(&val_mutex);
    k_condvar_init(&red_cv);
    k_condvar_init(&yellow_cv);
    k_condvar_init(&green_cv);
    k_sem_init(&release_sem, 0, 1);

    timing_init();
    timing_start();
    timing_t start_time = timing_counter_get();

    k_msleep(100);

    printk("Program started..\n");

    timing_t end_time = timing_counter_get();
    timing_stop();
    uint64_t timing_ns = timing_cycles_to_ns(timing_cycles_get(&start_time, &end_time));
    printk("Initialization: %lld\n", timing_ns);

    k_yield();

     while (true) {
        k_sleep(K_FOREVER);
    }

    return 0;
}
	

// Säikeiden määritykset
K_THREAD_DEFINE(dis_thread, STACKSIZE, dispatcher_task, NULL, NULL, NULL, PRIORITY, 0, 0);
K_THREAD_DEFINE(uart_thread, STACKSIZE, uart_task, NULL, NULL, NULL, PRIORITY, 0, 0);
K_THREAD_DEFINE(debug_thread, STACKSIZE, debug_task, NULL, NULL, NULL, PRIORITY, 0, 0);
K_THREAD_DEFINE(red_thread, STACKSIZE, red_led_task, NULL, NULL, NULL, PRIORITY, 0, 0);
K_THREAD_DEFINE(yellow_thread, STACKSIZE, yellow_led_task, NULL, NULL, NULL, PRIORITY, 0, 0);
K_THREAD_DEFINE(green_thread, STACKSIZE, green_led_task, NULL, NULL, NULL, PRIORITY, 0, 0);
```

## src/TimeParser.h
```c
#ifndef TIMEPARSER_H
#define TIMEPARSER_H

// Error codes
#define TIME_LEN_ERROR      -1 // palautetaan jos merkkejä on erimäärä kuin 6
#define TIME_ARRAY_ERROR    -2 // jos palautusarvo on tyhjä (NULL) tai sisältää vääriä merkkejä
#define TIME_VALUE_ERROR    -3 // palautetaan jos sekunteja tai minuutteja yli 59 tai tunteja yli 23
#define EASTEREGG           -4 // palauttaa tämän jos antaa arvoksi mun syntymäkellonajan
#define MARK_LEN_ERROR      -5 // jotain muuta
#define MARK_ARRAY_ERROR    -6
#define MARK_VALUE_ERROR    -7

using namespace std;

int time_parse(char *time);
int liikennevalot(char *merkki);

#endif
```

## src/debug.c
```c
#include <zephyr/kernel.h>
#include <zephyr/sys/printk.h>
#include "debug.h"

K_FIFO_DEFINE(data_fifo);

bool debug_enabled = true;

void debug_task(void *unused1, void *unused2, void *unused3)
{
    struct debug_data_t *received;

    while (true) {
        received = k_fifo_get(&data_fifo, K_FOREVER);
		
		if(debug_enabled) {
        printk("Debug received time: %lld ns\n", received->time);
        }
		k_free(received);

        k_yield();
	}
}
```

## src/dispatcher.c
```c
#include <zephyr/kernel.h>
#include <zephyr/device.h>
#include <zephyr/drivers/gpio.h>
#include <zephyr/timing/timing.h>
#include <stdlib.h>
#include <string.h>
#include <zephyr/sys/printk.h>
#include "dispatcher.h"
#include "uart.h"
#include "button.h"
#include "debug.h"
#include "led_task.h"
#include <assert.h>
#include <sys/types.h>
#include <ctype.h>

extern const struct gpio_dt_spec red;
extern const struct gpio_dt_spec green;

#define COMMAND_OK 0
//definaa tänne ne samat virhekoodit mitä oli TimeParser.h:ssa
#define TIME_LEN_ERROR      -1 // palautetaan jos merkkejä on erimäärä kuin 6
#define TIME_ARRAY_ERROR    -2 // jos palautusarvo on tyhjä (NULL) tai sisältää vääriä merkkejä
#define TIME_VALUE_ERROR    -3 // palautetaan jos sekunteja tai minuutteja yli 59 tai tunteja yli 23
#define EASTEREGG           -4 // palauttaa tämän jos antaa arvoksi mun syntymäkellonajan

extern struct k_timer timer;
extern struct k_timer timer2;
extern void timer_handler(struct k_timer *timer_id);
extern void timer_handler2(struct k_timer *timer_id);

int time_parse(char *time) {

	// how many seconds, default returns error
	//int seconds = TIME_LEN_ERROR;

	// TODO: Check that string is not null
	if(time == NULL){
		return TIME_ARRAY_ERROR;
	}

	if(strlen(time) != 6){
		return TIME_LEN_ERROR;
	}

	for (int i = 0; i < 6; i++){
		if(!isdigit(time[i])){
			return TIME_ARRAY_ERROR;
		}
	}

	// HHMMSS
	// HH values [0]
	// MM values [1]
	// SS values [2] 
		// Parse values from time string
	// For example: 124033 -> 12hour 40min 33sec
    int values[3];
	values[2] = atoi(time+4); // seconds
	time[4] = 0;
	values[1] = atoi(time+2); // minutes
	time[2] = 0;
	values[0] = atoi(time); // hours
	// Now you have:
	// values[0] hour
	// values[1] minute
	// values[2] second

	// TODO: Add boundary check time values: below zero or above limit not allowed
	// limits are 59 for minutes, 23 for hours, etc


	// TODO: Calculate return value from the parsed minutes and seconds
	// Otherwise error will be returned!
	// seconds = ...
	if (values[0] < 0 || values[0] > 23 ||
        values[1] < 0 || values[1] > 59 ||
        values[2] < 0 || values[2] > 59) {
        return TIME_VALUE_ERROR;
    }

	if (values[0] == 17 &&
        values[1] == 44 &&
        values[2] == 00) {
        return EASTEREGG;
    }

	int seconds = (values[0] * 3600) + (values[1] * 60) + values[2];
	
	if (seconds == 0){
		return TIME_VALUE_ERROR;
	}

	return seconds;
}


void dispatcher_task(void *unused1, void *unused2, void *unused3)
{
    
    while (true) {
        // Receive dispatcher data from uart_task fifo
        struct data_t *rec_item = k_fifo_get(&dispatcher_fifo, K_FOREVER);
        char sequence[20];
        memset(sequence,0,sizeof(sequence));
		strncpy(sequence, rec_item->msg, sizeof(sequence)-1);
		k_free(rec_item);

        bool just_numbers = true;
        if(strlen(sequence)==6)
        {
            for(int j = 0; j<6; j++)
            {
                if(!isdigit(sequence[j]))
                {
                    just_numbers = false;
                    break;
                }
             }
        } 
        else
        {
            just_numbers = false;
        }
        
       

        if (just_numbers){
        int ret = time_parse(sequence);
        // check parser return value
        if (ret > COMMAND_OK) {
            // send signal / message to mailbox
            // tänne keskeytystimer teemun ohjeista debug: k_time_init
            // Timer initialization
            printk("hyvä aika, ajetaan ajastin \n");
            k_timer_init(&timer, timer_handler, NULL);
            k_timer_start(&timer, K_SECONDS(ret), K_FOREVER);
            printk("sammutetaan kans se ledi");
            k_timer_init(&timer2, timer_handler2, NULL);
            k_timer_start(&timer2, K_SECONDS(ret+1), K_FOREVER);
            continue;
        } 
        else if (ret == TIME_VALUE_ERROR){
            printk("Sekunteja tai minuutteja yli 59 tai tunteja yli 23");
            continue;
        }
        else if (ret == TIME_ARRAY_ERROR){
            printk("Palautusarvo on NULL, ei siällä mitään tai sisältää vääriä merkkejä");
            continue;
        }
        else if (ret == TIME_LEN_ERROR){
            printk("Merkkejä on erimäärä kuin 6");
            continue;
        }
        else if (ret == EASTEREGG){
            printk("Annettu aika on Merin syntymäaika");
            k_timer_init(&timer, timer_handler, NULL);
            k_timer_start(&timer, K_SECONDS(ret), K_NO_WAIT);
            continue;
            
        }
    }




        // paina pelkkää enteriä niin tämä iskee päälle:
        __ASSERT(strlen(sequence) > 0, "Tyhjä merkkijono havaittu dispatcherissa!");

        uint64_t total_sequence_time = 0;
        int Tlaskuri = 0;
        int i = 0;

        timing_start();
        timing_t seq_start = timing_counter_get();

        while (sequence[i] != '\0')
		{
			char color = sequence[i];
			i++;

            

			if (color == 'T' || color == 't')
			{
				if (Tlaskuri == 0)
                {
					i = 0;
					printk("UUdestaan");
					Tlaskuri = 1;
					continue;
				}   
                else
                {
				    continue;
			    }
            }
            
            else if (color == 'D' || color == 'd')
            {
                debug_enabled = !debug_enabled;
                printk("Debug-tulostukset: %s\n", debug_enabled ? "PAALLA" : "POIS");
                continue;
            }
                        

			int duration = 1000;
			
            if (sequence[i]==',')
			{
				i++;
				duration=atoi(&sequence[i]);
                if (duration < 0) {
                    printk("VIRHE 2: Syötetty kesto on negatiivinen (%d)!\n", duration);
                 }
                 // syötä negatiivinen arvo niin tämä laukeaa
                __ASSERT(duration >= 0, "Kesto ei saa olla negatiivinen!");

				while (sequence[i] >= '0' && sequence[i] <= '9')
				{
					i++;
				}
			}

			k_mutex_lock(&val_mutex, K_FOREVER);
			active_color = color;
			active_duration = duration;

            timing_t start_time = timing_counter_get();

			if (color == 'R' || color == 'r')
			{
				k_condvar_signal(&red_cv);
			}
			else if(color == 'Y' || color == 'y')
			{
				k_condvar_signal(&yellow_cv);
			}
			else if(color == 'G' || color == 'g')
			{
				k_condvar_signal(&green_cv);
			}
            else
            {
                printk("VIRHE 3: Tuntematon merkki (%c) vastaanotettu!\n", color);
                // syötä joku muu kuin r ,g, y, t tai d niin tämä laukeaa
                __ASSERT(0, "Tuntematon merkki sekvenssissä!");
            }


			k_mutex_unlock(&val_mutex);
			k_sem_take(&release_sem, K_FOREVER);

            timing_t end_time = timing_counter_get();
            uint64_t timing_ns = timing_cycles_to_ns(timing_cycles_get(&start_time, &end_time));
            total_sequence_time += timing_ns;

            struct debug_data_t *buf = k_malloc(sizeof(struct debug_data_t));
            if (buf != NULL)
            {
                buf->time = timing_ns;
                k_fifo_put(&data_fifo, buf);
            }
            k_yield();
		}

		timing_t seq_end = timing_counter_get();
        timing_stop();
        uint64_t total_ns = timing_cycles_to_ns(timing_cycles_get(&seq_start, &seq_end));
        printk("Sekvenssin yhteenlaskettu kokonaisaika: %llu ns\n", total_ns);
	}
}



//tämä on vika vaihe vk5 tehtävässä. Voi laittaa hommaksi mitä vaan
// control led using timer interrupt
void timer_handler(struct k_timer *timer_id) {
    extern const struct gpio_dt_spec blue;
		gpio_pin_set_dt(&blue,1);
}

void timer_handler2(struct k_timer *timer_id) {
    extern const struct gpio_dt_spec blue;
		gpio_pin_set_dt(&blue,0);

}
```

## src/dispatcher.h
```c
#ifndef DISPATCHER_H
#define DISPATCHER_H

#include <zephyr/kernel.h>

void dispatcher_task(void *, void *, void *);

#endif
```

## src/led_task.c
```c
#include <zephyr/kernel.h>
#include <zephyr/sys/printk.h>
#include <zephyr/drivers/gpio.h>
#include "led_task.h"

const struct gpio_dt_spec red = GPIO_DT_SPEC_GET(DT_ALIAS(led0), gpios);
const struct gpio_dt_spec green = GPIO_DT_SPEC_GET(DT_ALIAS(led1), gpios);


struct k_mutex val_mutex;
struct k_condvar red_cv;
struct k_condvar green_cv;
struct k_condvar yellow_cv;
struct k_sem release_sem;

char active_color = '\0';
int active_duration = 1000;

int init_led() {
	int ret;

	ret = gpio_pin_configure_dt(&red, GPIO_OUTPUT_ACTIVE);
	if (ret < 0){
		return ret;
	}
	
	ret = gpio_pin_configure_dt(&green, GPIO_OUTPUT_ACTIVE);
	if (ret < 0){ 
        return ret;
    }

	gpio_pin_set_dt(&red, 0);
    gpio_pin_set_dt(&green, 0);
	printk("Led initialized ok\n");
	return 0;
}

void red_led_task(void *unused1, void *unused2, void *unused3)
{
    while (true){
        k_mutex_lock(&val_mutex, K_FOREVER);
        k_condvar_wait(&red_cv, &val_mutex, K_FOREVER);

        int duration = active_duration;
        k_mutex_unlock(&val_mutex);

        gpio_pin_set_dt(&red, 1);
        k_msleep(duration);
        gpio_pin_set_dt(&red, 0);

        k_sem_give(&release_sem);
    }
}

void yellow_led_task(void *unused1, void *unused2, void *unused3)
{
    while (true){
        k_mutex_lock(&val_mutex, K_FOREVER);
        k_condvar_wait(&yellow_cv, &val_mutex, K_FOREVER);

        int duration = active_duration;
        k_mutex_unlock(&val_mutex);

        gpio_pin_set_dt(&red, 1);
        gpio_pin_set_dt(&green, 1);
        k_msleep(duration);
        gpio_pin_set_dt(&red, 0);
        gpio_pin_set_dt(&green, 0);

        k_sem_give(&release_sem);
    }
}

void green_led_task(void *unused1, void *unused2, void *unused3)
{
    while (true){
        k_mutex_lock(&val_mutex, K_FOREVER);
        k_condvar_wait(&green_cv, &val_mutex, K_FOREVER);

        int duration = active_duration;
        k_mutex_unlock(&val_mutex);

        gpio_pin_set_dt(&green, 1);
        k_msleep(duration);
        gpio_pin_set_dt(&green, 0);

        k_sem_give(&release_sem);
    }
}
```
