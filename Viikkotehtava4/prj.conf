## CMakeLists.txt
```
cmake_minimum_required(VERSION 3.20.0)
find_package(Zephyr REQUIRED HINTS $ENV{ZEPHYR_BASE})

project(valot)

target_sources(app PRIVATE
    src/main.c
    src/button.c
    src/uart.c
    src/dispatcher.c
    src/debug.c
    src/led_task.c
)
```

## prj.conf
```kconfig
CONFIG_GPIO=y
CONFIG_LOG=y
CONFIG_SERIAL=y
CONFIG_UART_CONSOLE=y
CONFIG_LOG=y
CONFIG_HEAP_MEM_POOL_SIZE=1024
CONFIG_TIMING_FUNCTIONS=y
```

## src/main.c
```c
// Meri-Tuulia Turtinen
// TVT24SPL
// Tavoitellaan kolmea pistettä
// Nyt tehty ajan laskenta noihin tehtäviin ja lisätty kuvat omaan kansioon "kuvat"
// debugille tehty oma moduuli, jolloin viestit menevät erillisen debug taskin kautta
// debugin saa päälle ja pois painamalla d kirjainta
// lisätty kolme asserttia dispatcheriin


#include <zephyr/kernel.h>
#include <zephyr/sys/printk.h>
#include <zephyr/device.h>
#include <zephyr/drivers/gpio.h>
#include <zephyr/timing/timing.h>
#include "button.h"
#include "uart.h"
#include "dispatcher.h"
#include "debug.h"
#include "led_task.h"

// Thread initializations
#define STACKSIZE 500
#define PRIORITY 5


volatile int tilakone = 0; 
int led_state = 0;



int main(void)
{
    init_button();

    printk("Dispatcher example started\n");
    int ret = init_uart();
    if (ret != 0) {
        printk("UART initialization failed!\n");
        return ret;
    }
    
    ret = init_led();
    if (ret != 0) {
        printk("Led initialization failed!\n");
        return ret;
    }

    k_mutex_init(&val_mutex);
    k_condvar_init(&red_cv);
    k_condvar_init(&yellow_cv);
    k_condvar_init(&green_cv);
    k_sem_init(&release_sem, 0, 1);

    timing_init();
    timing_start();
    timing_t start_time = timing_counter_get();

    k_msleep(100);

    printk("Program started..\n");

    timing_t end_time = timing_counter_get();
    timing_stop();
    uint64_t timing_ns = timing_cycles_to_ns(timing_cycles_get(&start_time, &end_time));
    printk("Initialization: %lld\n", timing_ns);

    k_yield();

    
    return 0;
}

// Säikeiden määritykset
K_THREAD_DEFINE(dis_thread, STACKSIZE, dispatcher_task, NULL, NULL, NULL, PRIORITY, 0, 0);
K_THREAD_DEFINE(uart_thread, STACKSIZE, uart_task, NULL, NULL, NULL, PRIORITY, 0, 0);
K_THREAD_DEFINE(debug_thread, STACKSIZE, debug_task, NULL, NULL, NULL, PRIORITY, 0, 0);
K_THREAD_DEFINE(red_thread, STACKSIZE, red_led_task, NULL, NULL, NULL, PRIORITY, 0, 0);
K_THREAD_DEFINE(yellow_thread, STACKSIZE, yellow_led_task, NULL, NULL, NULL, PRIORITY, 0, 0);
K_THREAD_DEFINE(green_thread, STACKSIZE, green_led_task, NULL, NULL, NULL, PRIORITY, 0, 0);
```

## src/debug.c
```c
#include <zephyr/kernel.h>
#include <zephyr/sys/printk.h>
#include "debug.h"

K_FIFO_DEFINE(data_fifo);

void debug_task(void *unused1, void *unused2, void *unused3)
{
    struct debug_data_t *received;

    while (true) {
        received = k_fifo_get(&data_fifo, K_FOREVER);
        printk("Debug received time: %lld ns\n", received->time);
        k_free(received);

        k_yield();
    }
}
```

## src/debug.h
```c
#ifndef DEBUG_H
#define DEBUG_H

#include <zephyr/kernel.h>

struct debug_data_t {
    void *fifo_reserved;
    uint64_t time;
};

extern struct k_fifo data_fifo;
extern bool debug_enabled;

void debug_task(void *, void *, void *);

#endif
```

## src/dispatcher.c
```c
#include <zephyr/kernel.h>
#include <zephyr/device.h>
#include <zephyr/drivers/gpio.h>
#include <zephyr/timing/timing.h>
#include <stdlib.h>
#include <string.h>
#include <zephyr/sys/printk.h>
#include "dispatcher.h"
#include "uart.h"
#include "button.h"
#include "debug.h"
#include "led_task.h"
#include <assert.h>
#include <sys/types.h>

extern const struct gpio_dt_spec red;
extern const struct gpio_dt_spec green;

void dispatcher_task(void *unused1, void *unused2, void *unused3)
{
    while (true) {
        // Receive dispatcher data from uart_task fifo
        struct data_t *rec_item = k_fifo_get(&dispatcher_fifo, K_FOREVER);
        char sequence[20];
        memset(sequence,0,sizeof(sequence));
		strncpy(sequence, rec_item->msg, sizeof(sequence)-1);
		k_free(rec_item);

        // paina pelkkää enteriä niin tämä iskee päälle:
        __ASSERT(strlen(sequence) > 0, "Tyhjä merkkijono havaittu dispatcherissa!");

        uint64_t total_sequence_time = 0;
        int Tlaskuri = 0;
        int i = 0;

        timing_start();
        timing_t seq_start = timing_counter_get();

        while (sequence[i] != '\0')
		{
			char color = sequence[i];
			i++;

            

			if (color == 'T' || color == 't')
			{
				if (Tlaskuri == 0)
                {
					i = 0;
					printk("UUdestaan");
					Tlaskuri = 1;
					continue;
				}   
                else
                {
				    continue;
			    }
            }
            
            else if (color == 'D' || color == 'd')
            {
                debug_enabled = !debug_enabled;
                printk("Debug-tulostukset: %s\n", debug_enabled ? "PAALLA" : "POIS");
                continue;
            }
                        

			int duration = 1000;
			
            if (sequence[i]==',')
			{
				i++;
				duration=atoi(&sequence[i]);
                if (duration < 0) {
                    printk("VIRHE 2: Syötetty kesto on negatiivinen (%d)!\n", duration);
                 }
                 // syötä negatiivinen arvo niin tämä laukeaa
                __ASSERT(duration >= 0, "Kesto ei saa olla negatiivinen!");

				while (sequence[i] >= '0' && sequence[i] <= '9')
				{
					i++;
				}
			}

			k_mutex_lock(&val_mutex, K_FOREVER);
			active_color = color;
			active_duration = duration;

            timing_t start_time = timing_counter_get();

			if (color == 'R' || color == 'r')
			{
				k_condvar_signal(&red_cv);
			}
			else if(color == 'Y' || color == 'y')
			{
				k_condvar_signal(&yellow_cv);
			}
			else if(color == 'G' || color == 'g')
			{
				k_condvar_signal(&green_cv);
			}
            else
            {
                printk("VIRHE 3: Tuntematon merkki (%c) vastaanotettu!\n", color);
                // syötä joku muu kuin r ,g, y, t tai d niin tämä laukeaa
                __ASSERT(0, "Tuntematon merkki sekvenssissä!");
            }


			k_mutex_unlock(&val_mutex);
			k_sem_take(&release_sem, K_FOREVER);

            timing_t end_time = timing_counter_get();
            uint64_t timing_ns = timing_cycles_to_ns(timing_cycles_get(&start_time, &end_time));
            total_sequence_time += timing_ns;

            struct debug_data_t *buf = k_malloc(sizeof(struct debug_data_t));
            if (buf != NULL)
            {
                buf->time = timing_ns;
                k_fifo_put(&data_fifo, buf);
            }
            k_yield();
		}

		timing_t seq_end = timing_counter_get();
        timing_stop();
        uint64_t total_ns = timing_cycles_to_ns(timing_cycles_get(&seq_start, &seq_end));
        printk("Sekvenssin yhteenlaskettu kokonaisaika: %llu ns\n", total_ns);
	}
}
```

## src/uart.c
```c
/********************
 * UART task
 */
#include <zephyr/kernel.h>
#include <zephyr/device.h>
#include <zephyr/drivers/uart.h>
#include <zephyr/sys/printk.h>
#include <string.h>
#include "uart.h"

#define UART_DEVICE_NODE DT_CHOSEN(zephyr_shell_uart)
static const struct device *const uart_dev = DEVICE_DT_GET(UART_DEVICE_NODE);

K_FIFO_DEFINE(dispatcher_fifo);

int init_uart(void) {
    if (!device_is_ready(uart_dev)) {
        printk("UART device not ready\n");
        return 1;
    } 
    return 0;
}

 void uart_task(void *unused1, void *unused2, void *unused3)
{
	// Received character from UART
	char rc=0;
	// Message from UART
	char uart_msg[20];
	memset(uart_msg,0,20);
	int uart_msg_cnt = 0;

	while (true) {
		// Ask UART if data available
		if (uart_poll_in(uart_dev,&rc) == 0) {
			//printk("Saatu merkki: %c\n", rc);
			
			// If character is not newline, add to UART message buffer
			if (rc != '\r') {
				uart_msg[uart_msg_cnt] = rc;
				uart_msg_cnt++;
			// Character is newline, copy dispatcher data and put to FIFO buffer
			} else {
				printk("UART msg: %s\n", uart_msg);
                                
                // FIFO Stuff begins
				
                struct data_t *buf = k_malloc(sizeof(struct data_t));
				if (buf == NULL) {
					return;
				}
				// Copy UART message to dispatcher data
				// strncpy(buf->msg, 20, uart_msg); // mitä ihmettä, miksi kaatuu!!
				snprintf(buf->msg, 20, "%s", uart_msg);

				// You need to:
				// Put dispatcher data to FIFO buffer
                k_fifo_put(&dispatcher_fifo, buf);
				// Clear UART receive buffer
				uart_msg_cnt = 0;
				memset(uart_msg,0,20);

				// Clear UART message buffer
				uart_msg_cnt = 0;
				memset(uart_msg,0,20);
			}
		}
		k_msleep(10);
                //return 0;
	}
	
}
```
